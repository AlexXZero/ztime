## boards/arm/pinetime/Kconfig.board
```kconfig
# PineTime watch board configuration

config BOARD_PINETIME     
	bool "pinetime"
	depends on SOC_NRF52832_QFAA
```

## boards/arm/pinetime/Kconfig.defconfig
```kconfig
# PineTime watch board configuration

if BOARD_PINETIME

config BOARD
	default "pinetime"

config BT_CTLR
	default BT

endif # BOARD_PINETIME
```

## boards/arm/pinetime/pinetime_defconfig
```kconfig
CONFIG_SOC_SERIES_NRF52X=y
CONFIG_SOC_NRF52832_QFAA=y
CONFIG_BOARD_PINETIME=y

CONFIG_ARM_MPU=y

CONFIG_GPIO=y

# use P0.09 and P0.10 as GPIOs
CONFIG_NFCT_PINS_AS_GPIOS=y

# use P0.21 as RST
CONFIG_GPIO_AS_PINRESET=y
```
